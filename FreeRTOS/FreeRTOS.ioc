# file: FreeRTOS.ioc
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FREERTOS.CountingSemaphores01=CanRxSemaphore,10,Dynamic,NULL;CanTxSemaphore,10,Dynamic,NULL;LinRxSemaphore,10,Dynamic,NULL;LinTxSemaphore,10,Dynamic,NULL
FREERTOS.Tasks01=defaultTask,0,128,StartDefaultTask,Default,NULL,Dynamic,NULL,NULL;Task_can_recept,2,128,can_reception,Default,NULL,Dynamic,NULL,NULL;Task_can_send,2,128,can_send,Default,NULL,Dynamic,NULL,NULL;Task_can_proces,0,128,can_process,Default,NULL,Dynamic,NULL,NULL;Task_lin_proces,0,128,lin_process,Default,NULL,Dynamic,NULL,NULL;Task_lin_send,2,128,lin_send,Default,NULL,Dynamic,NULL,NULL
FREERTOS.Timers01=Timer_Ask_comodo,ask_comodo,osTimerPeriodic,Default,NULL,Dynamic,NULL
FREERTOS.configUSE_COUNTING_SEMAPHORES=1
FREERTOS.configUSE_NEWLIB_REENTRANT=1
FREERTOS.configUSE_TIMERS=1
Mcu.Family=STM32F4
Mcu.Name=STM32F407V(E-G)Tx
Mcu.Package=LQFP100
NVIC.PriorityGroup=NVIC_PRIORITYGROUP_4
NVIC.TIM6_DAC_IRQn=true\:15\:0\:false\:false\:true\:false\:false\:true\:true
NVIC.TimeBase=TIM6_DAC_IRQn
NVIC.TimeBaseIP=TIM6
PA13.Mode=Serial_Wire
PA13.Signal=SYS_JTMS-SWDIO
PA14.Mode=Serial_Wire
PA14.Signal=SYS_JTCK-SWCLK
PH0-OSC_IN.Mode=HSE-External-Oscillator
PH0-OSC_IN.Signal=RCC_OSC_IN
PH1-OSC_OUT.Mode=HSE-External-Oscillator
PH1-OSC_OUT.Signal=RCC_OSC_OUT
ProjectManager.HeapSize=0x200
ProjectManager.StackSize=0x400
ProjectManager.TargetToolchain=STM32CubeIDE
RCC.48MHZClocksFreq_Value=48000000
RCC.AHBFreq_Value=168000000
RCC.APB1CLKDivider=RCC_HCLK_DIV4
RCC.APB1Freq_Value=42000000
RCC.APB1TimFreq_Value=84000000
RCC.APB2CLKDivider=RCC_HCLK_DIV2
RCC.APB2Freq_Value=84000000
RCC.APB2TimFreq_Value=168000000
RCC.CortexFreq_Value=168000000
RCC.HCLKFreq_Value=168000000
RCC.HSE_VALUE=8000000
RCC.HSI_VALUE=16000000
RCC.LSE_VALUE=32768
RCC.PLLM=8
RCC.PLLN=336
RCC.PLLQ=7
RCC.PLLSourceVirtual=RCC_PLLSOURCE_HSE
RCC.SYSCLKFreq_VALUE=168000000
RCC.SYSCLKSource=RCC_SYSCLKSOURCE_PLLCLK
RCC.VCOOutputFreq_Value=336000000
VP_FREERTOS_VS_CMSIS_V1.Mode=CMSIS_V1
VP_SYS_VS_tim6.Mode=TIM6
board=STM32F407G-DISC1

// file: Core/Src/main.c
/* USER CODE BEGIN Header */
/**
  ******************************************************************************
  * @file           : main.c
  * @brief          : Main program body
  ******************************************************************************
  * @attention
  *
  * Copyright (c) 2023 STMicroelectronics.
  * All rights reserved.
  *
  * This software is licensed under terms that can be found in the LICENSE file
  * in the root directory of this software component.
  * If no LICENSE file comes with this software, it is provided AS-IS.
  *
  ******************************************************************************
  */
/* USER CODE END Header */
#include "main.h"
#include "cmsis_os.h"

/* USER CODE BEGIN PD */
#define LIN_MODE 1
/* USER CODE END PD */

osThreadId defaultTaskHandle;
osThreadId Task_can_receptHandle;
osThreadId Task_can_sendHandle;
osThreadId Task_can_procesHandle;
osThreadId Task_lin_procesHandle;
osThreadId Task_lin_sendHandle;
osTimerId Timer_Ask_comodoHandle;
osSemaphoreId CanRxSemaphoreHandle;
osSemaphoreId CanTxSemaphoreHandle;
osSemaphoreId LinRxSemaphoreHandle;
osSemaphoreId LinTxSemaphoreHandle;
/* USER CODE BEGIN PV */
CircularBufferCan* CanTxBuffer;
CircularBufferCan* CanRxBuffer;
CircularBufferLin* LinTxBuffer;
CircularBufferLin* LinRxBuffer;

CAN_frame Ask_comodo_frame; //RTC frame sent to the comodo

/* USER CODE END PV */

void SystemClock_Config(void);
static void MX_GPIO_Init(void);
void StartDefaultTask(void const * argument);
void can_reception(void const * argument);
void can_send(void const * argument);
void can_process(void const * argument);
void lin_process(void const * argument);
void lin_send(void const * argument);
void ask_comodo(void const * argument);

/* USER CODE BEGIN 0 */
// Interrupt handler for CAN1 RX0
void CAN1_RX0_IRQHandler(void)
{
    if (CAN1->RF0R & CAN_RF0R_FMP0) // check if there is a message in the FIFO
    {
    	 // clear the message from the FIFO
    	CAN1->RF0R |= CAN_RF0R_RFOM0;

        // send a message to task
        osSignalSet(Task_can_receptHandle, 0x01);

    }
}

void USART3_IRQHandler(void)
{
		if(USART3->SR & USART_SR_RXNE || USART3->SR & USART_SR_LBD_Msk){
			slave_response();
		}

}
/* USER CODE END 0 */

int main(void)
{
  /* USER CODE BEGIN 1 */
	CanTxBuffer = getNewBufferCan();
	CanRxBuffer = getNewBufferCan();
	LinTxBuffer = getNewBufferLin();
	LinRxBuffer = getNewBufferLin();

	Ask_comodo_frame.ID = 0x10510111;
	Ask_comodo_frame.RTR = 1;
	Ask_comodo_frame.IDE = 1;
	Ask_comodo_frame.DLC = 0;

  /* USER CODE END 1 */

  /* MCU Configuration--------------------------------------------------------*/

  /* Reset of all peripherals, Initializes the Flash interface and the Systick. */
  HAL_Init();

  /* USER CODE BEGIN Init */
  CAN_GPIO_Init();
  CAN_Counter_Init();
  //2.3
  //32bit mode, list mode
  //ID = 0x010,standard ID, accept both data and request frame
  CAN_config(1,1,(0x10 << 5),0x2,(0x10 << 5),0x00); //TODO init with right ID

  /* USER CODE END Init */

  /* Configure the system clock */
  SystemClock_Config();

  /* Initialize all configured peripherals */
  MX_GPIO_Init();

  /* Create the semaphores(s) */
  /* definition and creation of CanRxSemaphore */
  osSemaphoreDef(CanRxSemaphore);
  CanRxSemaphoreHandle = osSemaphoreCreate(osSemaphore(CanRxSemaphore), 10);

  /* definition and creation of CanTxSemaphore */
  osSemaphoreDef(CanTxSemaphore);
  CanTxSemaphoreHandle = osSemaphoreCreate(osSemaphore(CanTxSemaphore), 10);

  /* definition and creation of LinRxSemaphore */
  osSemaphoreDef(LinRxSemaphore);
  LinRxSemaphoreHandle = osSemaphoreCreate(osSemaphore(LinRxSemaphore), 10);

  /* definition and creation of LinTxSemaphore */
  osSemaphoreDef(LinTxSemaphore);
  LinTxSemaphoreHandle = osSemaphoreCreate(osSemaphore(LinTxSemaphore), 10);

  /* Create the timer(s) */
  /* definition and creation of Timer_Ask_comodo */
  osTimerDef(Timer_Ask_comodo, ask_comodo);
  Timer_Ask_comodoHandle = osTimerCreate(osTimer(Timer_Ask_comodo), osTimerPeriodic, NULL);

  /* Create the thread(s) */
  /* definition and creation of defaultTask */
  osThreadDef(defaultTask, StartDefaultTask, osPriorityNormal, 0, 128);
  defaultTaskHandle = osThreadCreate(osThread(defaultTask), NULL);

  /* definition and creation of Task_can_recept */
  osThreadDef(Task_can_recept, can_reception, osPriorityHigh, 0, 128);
  Task_can_receptHandle = osThreadCreate(osThread(Task_can_recept), NULL);

  /* definition and creation of Task_can_send */
  osThreadDef(Task_can_send, can_send, osPriorityHigh, 0, 128);
  Task_can_sendHandle = osThreadCreate(osThread(Task_can_send), NULL);

  /* definition and creation of Task_can_proces */
  osThreadDef(Task_can_proces, can_process, osPriorityNormal, 0, 128);
  Task_can_procesHandle = osThreadCreate(osThread(Task_can_proces), NULL);

  /* definition and creation of Task_lin_proces */
  osThreadDef(Task_lin_proces, lin_process, osPriorityNormal, 0, 128);
  Task_lin_procesHandle = osThreadCreate(osThread(Task_lin_proces), NULL);

  /* definition and creation of Task_lin_send */
  osThreadDef(Task_lin_send, lin_send, osPriorityHigh, 0, 128);
  Task_lin_sendHandle = osThreadCreate(osThread(Task_lin_send), NULL);

  /* Start scheduler */
  osKernelStart();
  /* We should never get here as control is now taken by the scheduler */
  /* Infinite loop */
  while (1)
  {

  }
}

void SystemClock_Config(void)
{
  RCC_OscInitTypeDef RCC_OscInitStruct = {0};
  RCC_ClkInitTypeDef RCC_ClkInitStruct = {0};

  /** Configure the main internal regulator output voltage
  */
  __HAL_RCC_PWR_CLK_ENABLE();
  __HAL_PWR_VOLTAGESCALING_CONFIG(PWR_REGULATOR_VOLTAGE_SCALE1);

  /** Initializes the RCC Oscillators according to the specified parameters
  * in the RCC_OscInitTypeDef structure.
  */
  RCC_OscInitStruct.OscillatorType = RCC_OSCILLATORTYPE_HSE;
  RCC_OscInitStruct.HSEState = RCC_HSE_ON;
  RCC_OscInitStruct.PLL.PLLState = RCC_PLL_ON;
  RCC_OscInitStruct.PLL.PLLSource = RCC_PLLSOURCE_HSE;
  RCC_OscInitStruct.PLL.PLLM = 8;
  RCC_OscInitStruct.PLL.PLLN = 336;
  RCC_OscInitStruct.PLL.PLLP = RCC_PLLP_DIV2;
  RCC_OscInitStruct.PLL.PLLQ = 7;
  if (HAL_RCC_OscConfig(&RCC_OscInitStruct) != HAL_OK)
  {
    Error_Handler();
  }

  /** Initializes the CPU, AHB and APB buses clocks
  */
  RCC_ClkInitStruct.ClockType = RCC_CLOCKTYPE_HCLK|RCC_CLOCKTYPE_SYSCLK
                              |RCC_CLOCKTYPE_PCLK1|RCC_CLOCKTYPE_PCLK2;
  RCC_ClkInitStruct.SYSCLKSource = RCC_SYSCLKSOURCE_PLLCLK;
  RCC_ClkInitStruct.AHBCLKDivider = RCC_SYSCLK_DIV1;
  RCC_ClkInitStruct.APB1CLKDivider = RCC_HCLK_DIV4;
  RCC_ClkInitStruct.APB2CLKDivider = RCC_HCLK_DIV2;

  if (HAL_RCC_ClockConfig(&RCC_ClkInitStruct, FLASH_LATENCY_5) != HAL_OK)
  {
    Error_Handler();
  }
}

static void MX_GPIO_Init(void)
{

  /* GPIO Ports Clock Enable */
  __HAL_RCC_GPIOH_CLK_ENABLE();
  __HAL_RCC_GPIOA_CLK_ENABLE();

}

void StartDefaultTask(void const * argument)
{
  for(;;)
  {
    osDelay(1);
  }
}

/* USER CODE BEGIN Header_can_reception */
/**
* @brief Function implementing the Task_can_recept thread.
* This Task fetch can frame when it's given a signal by a CAN_RX interrupt
* Once it has fetch the frame, it adds it to a cricular buffer, and release a semaphore so it can be processed
* @param argument: Not used
* @retval None
*/
/* USER CODE END Header_can_reception */
void can_reception(void const * argument)
{
  /* USER CODE BEGIN can_reception */
  /* Infinite loop */
  for(;;)
  {
	osSignalWait(0,0); //wait for the interruption to generate a signal
    CAN_frame recived_frame = CAN_frameFetch(); //Fetch the frame from the DR
    pushToBufferCan(CanRxBuffer,recived_frame);
    osSemaphoreRelease(CanRxSemaphoreHandle); //Release the semaphore so the frame can be processed
  }
  /* USER CODE END can_reception */
}

/* USER CODE BEGIN Header_can_send */
/**
* @brief Function implementing the Task_can_send thread.
* This Task wait for a semaphore that is released each time a frame is added to the TxBuffer
* It then fetch this frame and send it to the bus
* @param argument: Not used
* @retval None
*/
/* USER CODE END Header_can_send */
void can_send(void const * argument)
{
  /* USER CODE BEGIN can_send */
  /* Infinite loop */
  for(;;)
  {
	  osSemaphoreWait(CanTxSemaphoreHandle,0); //Waiting for a semaphore
	  CAN_frame *frame;
	  pullFromBufferCan(CanTxBuffer,frame); //Fetching the frame from the buffer
	  CAN_sendFrame(*frame); //Sending the frame
  }
  /* USER CODE END can_send */
}

void can_process(void const * argument)
{
	osTimerStart (Timer_Ask_comodoHandle,500);// Activate the timer to ask the comodo every 500ms
  /* USER CODE BEGIN can_process */
  /* Infinite loop */
  for(;;)
  {
	  // Fetch a CAN frame from the queue
	  osSemaphoreWait(CanRxSemaphoreHandle,0); //Waiting for a semaphore
	  CAN_frame *frame;
	  pullFromBufferCan(CanRxBuffer,frame);
	  if(frame->ID == 0x10015111){ //If it's the response from the comodo
		  serial_puts("Recived a CAN frame with comodo info\r\n");
		  serial_puts("Sending a LIN frame containing the info\r\n");

		  //*Sending the info via LIN*//
		  LINMSG lin_frame;
		  lin_frame.ID = 0x44;
		  lin_frame.length = 1;
		  lin_frame.data[0] = frame->data[0];
		  lin_frame.checksum = checksum(1,lin_frame.data);

		  //Puting the frame in the buffer
		  pushToBufferLin(LinTxBuffer,lin_frame);
		  //Unblocking the sendLin
		  osSemaphoreRelease(LinTxSemaphoreHandle);
	  }else if(frame->ID == 0x10015112){

		  //*Sending the info via LIN*//
		  LINMSG* lin_frame;
		  lin_frame->ID = SLAVE_ADDR_READ;
		  lin_frame->length = 1;
		  lin_frame->data[0] = frame->data[0];
		  lin_frame->checksum = checksum(1,lin_frame->data);
		  SendMessage(lin_frame,0); //Sending the message manually as it's in "slave mode"

	  }
  }
  /* USER CODE END can_process */
}

void lin_process(void const * argument)
{
  /* USER CODE BEGIN lin_process */
  /* Infinite loop */
  for(;;){
	  osSemaphoreWait(LinRxSemaphoreHandle,0);
	  LINMSG* frame;
	  pullFromBufferLin(LinRxBuffer,frame);
	  if (frame->ID == SLAVE_ADDR_READ){
		  serial_puts("Received a request via LIN");
		  serial_puts("Asking the comodo via can and sending the result back");

		  CAN_frame can_frame;
		  can_frame.ID = 0x10510112;
		  can_frame.RTR = 1;
		  can_frame.IDE = 1;
		  can_frame.DLC = 0;
		  pushToBufferCan(CanTxBuffer,can_frame);
		  osSemaphoreRelease(CanTxSemaphoreHandle);
	  }
  }
  /* USER CODE END lin_process */
}

void lin_send(void const * argument)
{
  /* USER CODE BEGIN lin_send */
	/* Infinite loop */
	for(;;){
		osSemaphoreWait(LinTxSemaphoreHandle,0); //Waiting for a semaphore
		LINMSG* frame;
		pullFromBufferLin(LinTxBuffer,frame);
		SendMessage(frame,LIN_MODE);
	}
  /* USER CODE END lin_send */
}

/* ask_comodo function */
void ask_comodo(void const * argument)
{
  /* USER CODE BEGIN ask_comodo */
	CAN_sendFrame(Ask_comodo_frame);
  /* USER CODE END ask_comodo */
}

void HAL_TIM_PeriodElapsedCallback(TIM_HandleTypeDef *htim)
{
  if (htim->Instance == TIM6) {
    HAL_IncTick();
  }
}

void Error_Handler(void)
{
  __disable_irq();
  while (1)
  {
  }
}
